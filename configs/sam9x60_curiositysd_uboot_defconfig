## configs/sam9x60_curiositysd_uboot_defconfig
```kconfig
CONFIG_SAM9X60=y
CONFIG_DEBUG=y
CONFIG_DDRC=y
CONFIG_DDR_SET_BY_DEVICE=y
CONFIG_SDCARD=y
CONFIG_THUMB=y
CONFIG_BOARD_QUIRK_SAM9X60_CURIOSITY=y
# 64MB
CONFIG_DDR_W9751G6KB=y
CONFIG_JUMP_ADDR="0x23E00000"
# 128MB
#CONFIG_DDR_W971GG6SB=y
#CONFIG_JUMP_ADDR="0x23F00000"
```
